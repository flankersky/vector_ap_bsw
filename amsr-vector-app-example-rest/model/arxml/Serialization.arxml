AUTOSAR XML (schema 00042)
package /vector/rest
  someip data prototype transformation props subtractMethodTransformationProps: data-prototypes=calcPortP, someip-transformation-props=subtractMethodTransformationProps
  transformation props set calcTransformationProps
    ap someip transformation props restfulInterfaceTransformationProps: alignment=16, byte-order=big-endian, session-handling=SESSION-HANDLING-ACTIVE, size-of-array-length-field=2, size-of-struct-length-field=1, size-of-union-length-field=1, size-of-union-type-selector-field=1
    ap someip transformation props subtractMethodTransformationProps: byte-order=big-endian
  transformation props to service interface mapping set calcTransformationPropsOfInterface: transformation-props-to-service-interface-mapping{service-interface=restfulInterface, transformation-props=restfulInterfaceTransformationProps}
