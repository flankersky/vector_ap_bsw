AUTOSAR XML (schema 00042)
package /deployment
  someip service interface restfulInterface_Someip: service-interface=restfulInterface, service-interface-id=9999, service-interface-version={major-version=1, minor-version=0}
