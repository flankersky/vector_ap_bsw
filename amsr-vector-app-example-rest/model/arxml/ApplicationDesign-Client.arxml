AUTOSAR XML (schema 00042)
package /vector/rest
  adaptive application sw component type restfulClientSWC
    require port restPortR: required-interface=restfulInterface
  executable restfulClientExe: transformation-props-to-service-interface-mapping-set=calcTransformationPropsOfInterface
    root sw component prototype restfulClientRootSwc: application-type=restfulClientSWC
  adaptive autosar application restfulClient: category=APPLICATION_LEVEL, executable=restfulClientExe
