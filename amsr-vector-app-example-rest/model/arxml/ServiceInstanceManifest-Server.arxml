AUTOSAR XML (schema 00042)
package /vector/rest
  provided someip service instance restful_ProvidedSomeipServiceInstance: service-interface=restfulInterface_Someip, sd-server-config={initial-offer-behavior={initial-delay-max-value=0.1, initial-delay-min-value=0.01, initial-repetitions-base-delay=0.2, initial-repetitions-max=3}, offer-cyclic-delay=2.0, request-response-delay={max-value=1.5, min-value=1.5}, service-offer-time-to-live=3}, service-instance-id=9999
  someip service instance to machine mapping restful_ProvidedSomeipServiceInstance_toMachine: communication-connector=ServerConnector, service-instance=restful_ProvidedSomeipServiceInstance, ipv-4-multicast-ip-address=224.0.0.1, service-instance-port-config{event-multicast-udp-port=port-number=12330, tcp-port=port-number=31402}
  service instance to application endpoint mapping restful_ProvidedSomeipServiceInstance_toPort: port-prototype=restServerRootSwc.calcPortP, process=restServerProc, service-instance=restful_ProvidedSomeipServiceInstance
