AUTOSAR XML (schema 00042)
package /vector
  ethernet cluster Eth
    ethernet physical channel EthCh1
      network endpoint CalcNetworkEndpoint:
        fully-qualified-domain-name=calc.vector.com
        infrastructure-services=dhcp-server-configuration=ipv-4-dhcp-server-configuration={address-range-lower-bound=196.168.7.2, address-range-upper-bound=196.168.7.9, default-gateway=196.168.7.1, default-lease-time=600, dns-server-addresses=196.168.7.1, network-mask=255.255.255.0}
        network-endpoint-addresses=ipv-4-configuration={ipv-4-address=192.168.1.5, ipv-4-address-source=FIXED, ttl=5}
      network endpoint SdMulticastEndpoint: network-endpoint-addresses=ipv-4-configuration=ipv-4-address=224.0.0.17
      vlan restfulVlan: vlan-identifier=12
  mode declaration group VehicleStateMachine: initial-mode=Startup
    4 x mode:
      Startup: value=0
      Running: value=1
      Shutdown: value=2
      Restart: value=3
