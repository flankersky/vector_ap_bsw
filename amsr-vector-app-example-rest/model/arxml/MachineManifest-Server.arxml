AUTOSAR XML (schema 00042)
package /vector
  machine ServerMachine: service-discover-configs=someip-service-discovery={multicast-sd-ip-address=SdMulticastEndpoint, someip-service-discovery-port=12330}
    ethernet communication connector ServerConnector: unicast-network-endpoint=CalcNetworkEndpoint
    machine-mode-machines:
      mode declaration group prototype ServerModeMachine: type=VehicleStateMachine
    os module instantiation OsModule
      resource group OsModuleResources
    generic module instantiation ServerModule: process=restServerProc
