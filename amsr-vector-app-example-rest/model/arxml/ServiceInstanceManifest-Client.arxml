AUTOSAR XML (schema 00042)
package /vector/rest
  required someip service instance restful_RequiredSomeipServiceInstance: service-interface=restfulInterface_Someip, required-service-instance-id=9999, required-service-version={major-version=1, minor-version=ANY}
  someip service instance to machine mapping restful_RequiredSomeipServiceInstance_toMachine: communication-connector=ClientConnector, service-instance=restful_RequiredSomeipServiceInstance, ipv-4-multicast-ip-address=224.0.0.1, service-instance-port-config=tcp-port=port-number=31401
  service instance to application endpoint mapping restful_RequiredSomeipServiceInstance_toPort: port-prototype=restfulClientRootSwc.restPortR, process=restfulClientProc, service-instance=restful_RequiredSomeipServiceInstance
