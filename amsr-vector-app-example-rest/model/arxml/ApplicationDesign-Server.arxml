AUTOSAR XML (schema 00042)
package /vector/rest
  adaptive application sw component type restServer
    provide port calcPortP: provided-interface=restfulInterface
  executable restServerExe: transformation-props-to-service-interface-mapping-set=calcTransformationPropsOfInterface
    root sw component prototype restServerRootSwc: application-type=restServer
  adaptive autosar application restfulServer: category=APPLICATION_LEVEL, executable=restServerExe
