AUTOSAR XML (schema 00042)
package /vector
  machine ClientMachine: service-discover-configs=someip-service-discovery={multicast-sd-ip-address=SdMulticastEndpoint, someip-service-discovery-port=12330}
    ethernet communication connector ClientConnector: unicast-network-endpoint=CalcNetworkEndpoint
    machine-mode-machines:
      mode declaration group prototype ClientModeMachine: type=VehicleStateMachine
    os module instantiation OsModule
      resource group OsModuleResources
    generic module instantiation ClientModule: process=restfulClientProc
