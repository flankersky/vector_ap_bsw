AUTOSAR XML (schema 00042)
package /vector/rest
  process restServerProc: executable=restServerExe, mode-dependent-startup-config{machine-mode=ServerModeMachine.Running, startup-config=StartupModeIndependent}
    application mode machine RestServerModes: type=ApplicationStateMachine
  startup config set ServerStartupConfigs
    startup config StartupModeIndependent: scheduling-policy=SCHEDULING-POLICY-FIFO, scheduling-priority=1, startup-option{option-argument=../etc/configuration.json, option-kind=COMMAND-LINE-SHORT-FORM, option-name=c}
