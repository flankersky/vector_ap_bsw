AUTOSAR XML (schema 00042)
package /vector/rest
  process restfulClientProc: executable=restfulClientExe, mode-dependent-startup-config{machine-mode=ClientModeMachine.Running, startup-config=StartupModeIndependent}
  startup config set ClientStartupConfigs
    startup config StartupModeIndependent: scheduling-policy=SCHEDULING-POLICY-FIFO, scheduling-priority=1, startup-option{option-argument=../etc/configuration.json, option-kind=COMMAND-LINE-SHORT-FORM, option-name=c}
