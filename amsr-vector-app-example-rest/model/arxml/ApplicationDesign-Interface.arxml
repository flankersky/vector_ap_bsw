AUTOSAR XML (schema 00042)
package /vector/restfulService
  service interface restfulInterface
    namespaces:
      symbol props vector
      symbol props restfulService
