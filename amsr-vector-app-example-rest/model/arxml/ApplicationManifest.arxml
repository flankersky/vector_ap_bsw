AUTOSAR XML (schema 00042)
package /vector
  mode declaration group ApplicationStateMachine: initial-mode=Running
    mode Running: value=0
    mode Terminating: value=1
