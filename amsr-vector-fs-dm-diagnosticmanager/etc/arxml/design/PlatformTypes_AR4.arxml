AUTOSAR XML (schema 00043)
standard types defined: dtRef_const_VOID, dtRef_VOID, boolean, float32, float64, sint8, sint16, sint32, sint64, uint8, uint16, uint32, uint64
package /AUTOSAR_Platform/BaseTypes
  8 x base type, all with category=FIXED_LENGTH, base-type-size=64:
    sint_least8: base-type-encoding=2C, native-declaration=std::int_least8_t
    sint_least16: base-type-encoding=2C, native-declaration=std::int_least16_t
    sint_least32: base-type-encoding=2C, native-declaration=std::int_least32_t
    sint_least64: base-type-encoding=2C, native-declaration=std::int_least64_t
    uint_least8: base-type-encoding=NONE, native-declaration=std::uint_least8_t
    uint_least16: base-type-encoding=NONE, native-declaration=std::uint_least16_t
    uint_least32: base-type-encoding=NONE, native-declaration=std::uint_least32_t
    uint_least64: base-type-encoding=NONE, native-declaration=std::uint_least64_t
package /AUTOSAR_Platform/ImplementationDataTypes
  8 x impl type, all with category=VALUE, type-emitter=Platform_Type:
    sint_least8: base-type=sint_least8  # sint_least8 represents a signed integer with values defined by at least 8 bit.
    sint_least16: base-type=sint_least16  # sint_least16 represents a signed integer with values defined by at least 16 bit.
    sint_least32: base-type=sint_least32  # sint_least32 represents a signed integer with values defined by at least 32 bit.
    sint_least64: base-type=sint_least64  # sint_least64 represents a signed integer with values defined by at least 64 bit.
    uint_least8: base-type=uint_least8  # uint_least8 represents an unsigned integer with values defined by at least 8 bit.
    uint_least16: base-type=uint_least16  # uint_least16 represents an unsigned integer with values defined by at least 16 bit.
    uint_least32: base-type=uint_least32  # uint_least32 represents an unsigned integer with values defined by at least 32 bit.
    uint_least64: base-type=uint_least64  # uint_least64 represents an unsigned integer with values defined by at least 64 bit.
