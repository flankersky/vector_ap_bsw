AUTOSAR XML (schema 00043)
package /ara/diag
  adaptive application sw component type DiagnosticManagerSwc
  executable DiagnosticManagerExe
    root sw component prototype DiagnosticManagerRootSwc: application-type=DiagnosticManagerSwc
  adaptive autosar application DiagnosticManager: category=APPLICATION_LEVEL, executable=DiagnosticManagerExe
