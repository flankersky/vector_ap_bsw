AUTOSAR XML (schema 00043)
package /ara/diag
  adaptive application sw component type DiagnosticManagerSwc
    require port GenericUDSService_SWCL_A: required-interface=GenericUDSService
    require port DM_IPC_SWCL_TEST: required-interface=DM_IPC
