AUTOSAR XML (schema 00043)
package /ara/diag
  required someip service instance DiagnosticManager_RequiredSomeipServiceInstance_GenericUDSService: service-interface=GenericUDSService_Someip, required-service-instance-id=2001, required-service-version={major-version=1, minor-version=ANY}
  someip service instance to machine mapping DiagnosticManager_RequiredSomeipServiceInstance_GenericUDSService_toMachine: communication-connector=ClientConnector, service-instance=DiagnosticManager_RequiredSomeipServiceInstance_GenericUDSService, ipv-4-multicast-ip-address=224.0.0.1, tcp-port=31401
  service instance to port prototype mapping DiagnosticManager_RequiredSomeipServiceInstance_GenericUDSService_toPort: port-prototype=DiagnosticManagerRootSwc.GenericUDSService_SWCL_A, process=DiagnosticManagerProc, service-instance=DiagnosticManager_RequiredSomeipServiceInstance_GenericUDSService
  required someip service instance DiagnosticManager_RequiredSomeipServiceInstance_DM_IPC: service-interface=DM_IPC_Someip, required-service-instance-id=2005, required-service-version={major-version=1, minor-version=ANY}
  someip service instance to machine mapping DiagnosticManager_RequiredSomeipServiceInstance_DM_IPC_toMachine: communication-connector=ClientConnector, service-instance=DiagnosticManager_RequiredSomeipServiceInstance_DM_IPC, ipv-4-multicast-ip-address=224.0.0.1, tcp-port=31401
  service instance to port prototype mapping DiagnosticManager_RequiredSomeipServiceInstance_DM_IPC_toPort: port-prototype=DiagnosticManagerRootSwc.DM_IPC_SWCL_TEST, process=DiagnosticManagerProc, service-instance=DiagnosticManager_RequiredSomeipServiceInstance_DM_IPC
