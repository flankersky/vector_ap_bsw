AUTOSAR XML (schema 00043)
package /deployment
  someip service interface deployment GenericUDSService_Someip: service-interface=GenericUDSService, service-interface-id=2111, service-interface-version={major-version=1, minor-version=0}
    someip method deployment Service: method=Service, method-id=111, transport-protocol=TCP
  someip service interface deployment DM_IPC_Someip: service-interface=DM_IPC, service-interface-id=2100, service-interface-version={major-version=1, minor-version=0}
    someip method deployment Service: method=RequestData, method-id=100, transport-protocol=TCP
