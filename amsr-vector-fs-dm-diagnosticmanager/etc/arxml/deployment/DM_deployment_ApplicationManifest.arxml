AUTOSAR XML (schema 00043)
package /ara/diag
  process DiagnosticManagerProc: executable=DiagnosticManagerExe
