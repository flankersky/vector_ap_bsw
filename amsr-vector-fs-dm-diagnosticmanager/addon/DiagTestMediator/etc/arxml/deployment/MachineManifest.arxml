AUTOSAR XML (schema 00043)
package /vector
  ethernet cluster Eth
    ethernet physical channel EthCh1
      network endpoint DiagNetworkEndpoint: network-endpoint-addresses=ipv-4-configuration={ipv-4-address=192.168.1.5, ipv-4-address-source=FIXED, ttl=5}
      network endpoint SdMulticastEndpoint: network-endpoint-addresses=ipv-4-configuration=ipv-4-address=224.0.0.17
  mode declaration group VehicleStateMachine: initial-mode=Parking
    mode Parking: value=0
    mode Ignition: value=7
    mode Driving: value=12
