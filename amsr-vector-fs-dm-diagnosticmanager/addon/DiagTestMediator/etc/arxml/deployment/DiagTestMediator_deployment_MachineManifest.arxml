AUTOSAR XML (schema 00043)
package /vector
  machine ClientMachine: service-discover-configs=someip-service-discovery={multicast-sd-ip-address=SdMulticastEndpoint, someip-service-discovery-port=12330}
    ethernet communication connector ClientConnector: unicast-network-endpoint=DiagNetworkEndpoint
  machine ServerMachine: service-discover-configs=someip-service-discovery={multicast-sd-ip-address=SdMulticastEndpoint, someip-service-discovery-port=12330}
    ethernet communication connector ServerConnector: unicast-network-endpoint=DiagNetworkEndpoint
