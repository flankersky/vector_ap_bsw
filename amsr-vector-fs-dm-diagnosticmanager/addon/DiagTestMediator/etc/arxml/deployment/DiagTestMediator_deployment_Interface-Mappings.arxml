AUTOSAR XML (schema 00043)
package /vector/diag_test_mediator
  provided someip service instance DiagTestMediator_ProvidedSomeipServiceInstance_DM_IPC: service-interface=DM_IPC_Someip, sd-server-config={initial-offer-behavior={initial-delay-max-value=0.1, initial-delay-min-value=0.01, initial-repetitions-base-delay=0.2, initial-repetitions-max=3}, offer-cyclic-delay=2.0, request-response-delay={max-value=1.5, min-value=1.5}, service-offer-time-to-live=3}, service-instance-id=1000
  someip service instance to machine mapping DiagTestMediator_ProvidedSomeipServiceInstance_DM_IPC_toMachine: communication-connector=ServerConnector, service-instance=DiagTestMediator_ProvidedSomeipServiceInstance_DM_IPC, ipv-4-multicast-ip-address=224.0.0.1, tcp-port=31401
  service instance to port prototype mapping DiagTestMediator_ProvidedSomeipServiceInstance_DM_IPC_toPort: port-prototype=DiagTestMediatorRootSwc.DM_IPC_SWCL_TEST, process=DiagTestMediatorProc, service-instance=DiagTestMediator_ProvidedSomeipServiceInstance_DM_IPC
  required someip service instance DiagTestMediator_RequiredSomeipServiceInstance_DataIdentifier_SWCL_A_DID_4711: service-interface=DataIdentifier_SWCL_A_DID_4711_Someip, required-service-instance-id=2002, required-service-version={major-version=1, minor-version=ANY}
  someip service instance to machine mapping DiagTestMediator_RequiredSomeipServiceInstance_DataIdentifier_SWCL_A_DID_4711_toMachine: communication-connector=ClientConnector, service-instance=DiagTestMediator_RequiredSomeipServiceInstance_DataIdentifier_SWCL_A_DID_4711, ipv-4-multicast-ip-address=224.0.0.1, tcp-port=31401
  service instance to port prototype mapping DiagTestMediator_RequiredSomeipServiceInstance_DataIdentifier_SWCL_A_DID_4711_toPort: port-prototype=DiagTestMediatorRootSwc.DataIdentifier_SWCL_A_DID_4711, process=DiagTestMediatorProc, service-instance=DiagTestMediator_RequiredSomeipServiceInstance_DataIdentifier_SWCL_A_DID_4711
  required someip service instance DiagTestMediator_RequiredSomeipServiceInstance_DataIdentifier_SWCL_A_DID_F190: service-interface=DataIdentifier_SWCL_A_DID_F190_Someip, required-service-instance-id=2003, required-service-version={major-version=1, minor-version=ANY}
  someip service instance to machine mapping DiagTestMediator_RequiredSomeipServiceInstance_DataIdentifier_SWCL_A_DID_F190_toMachine: communication-connector=ClientConnector, service-instance=DiagTestMediator_RequiredSomeipServiceInstance_DataIdentifier_SWCL_A_DID_F190, ipv-4-multicast-ip-address=224.0.0.1, tcp-port=31401
  service instance to port prototype mapping DiagTestMediator_RequiredSomeipServiceInstance_DataIdentifier_SWCL_A_DID_F190_toPort: port-prototype=DiagTestMediatorRootSwc.DataIdentifier_SWCL_A_DID_F190, process=DiagTestMediatorProc, service-instance=DiagTestMediator_RequiredSomeipServiceInstance_DataIdentifier_SWCL_A_DID_F190
  required someip service instance DiagTestMediator_RequiredSomeipServiceInstance_RoutineControl_SWCL_A_RID_3009: service-interface=RoutineControl_SWCL_A_RID_3009_Someip, required-service-instance-id=2004, required-service-version={major-version=1, minor-version=ANY}
  someip service instance to machine mapping DiagTestMediator_RequiredSomeipServiceInstance_RoutineControl_SWCL_A_RID_3009_toMachine: communication-connector=ClientConnector, service-instance=DiagTestMediator_RequiredSomeipServiceInstance_RoutineControl_SWCL_A_RID_3009, ipv-4-multicast-ip-address=224.0.0.1, tcp-port=31401
  service instance to port prototype mapping DiagTestMediator_RequiredSomeipServiceInstance_RoutineControl_SWCL_A_RID_3009_toPort: port-prototype=DiagTestMediatorRootSwc.RoutineControl_SWCL_A_RID_3009, process=DiagTestMediatorProc, service-instance=DiagTestMediator_RequiredSomeipServiceInstance_RoutineControl_SWCL_A_RID_3009
