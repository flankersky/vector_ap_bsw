AUTOSAR XML (schema 00043)
package /deployment
  someip service interface deployment GenericUDSService_Someip: service-interface=GenericUDSService, service-interface-id=2111, service-interface-version={major-version=1, minor-version=0}
    someip method deployment Service: method=Service, method-id=111, transport-protocol=TCP
