AUTOSAR XML (schema 00043)
package /deployment
  someip service interface deployment DataIdentifier_SWCL_A_DID_4711_Someip: service-interface=DataIdentifier_SWCL_A_DID_4711, service-interface-id=2112, service-interface-version={major-version=1, minor-version=0}
    someip method deployment Read: method=Read, method-id=112, transport-protocol=TCP
    someip method deployment Write: method=Write, method-id=113, transport-protocol=TCP
    someip method deployment Cancel: method=Cancel, method-id=114, transport-protocol=TCP
  someip service interface deployment DataIdentifier_SWCL_A_DID_F190_Someip: service-interface=DataIdentifier_SWCL_A_DID_F190, service-interface-id=2113, service-interface-version={major-version=1, minor-version=0}
    someip method deployment Read: method=Read, method-id=115, transport-protocol=TCP
    someip method deployment Write: method=Write, method-id=116, transport-protocol=TCP
    someip method deployment Cancel: method=Cancel, method-id=117, transport-protocol=TCP
  someip service interface deployment RoutineControl_SWCL_A_RID_3009_Someip: service-interface=RoutineControl_SWCL_A_RID_3009, service-interface-id=2114, service-interface-version={major-version=1, minor-version=0}
    someip method deployment Start: method=Start, method-id=118, transport-protocol=TCP
    someip method deployment Stop: method=Stop, method-id=119, transport-protocol=TCP
    someip method deployment RequestResults: method=RequestResults, method-id=120, transport-protocol=TCP
