AUTOSAR XML (schema 00043)
package /vector/diag_test_app
  provided someip service instance DiagTestApp_ProvidedSomeipServiceInstance_GenericUDSService: service-interface=GenericUDSService_Someip, sd-server-config={initial-offer-behavior={initial-delay-max-value=0.1, initial-delay-min-value=0.01, initial-repetitions-base-delay=0.2, initial-repetitions-max=3}, offer-cyclic-delay=2.0, request-response-delay={max-value=1.5, min-value=1.5}, service-offer-time-to-live=3}, service-instance-id=2001
  someip service instance to machine mapping DiagTestApp_ProvidedSomeipServiceInstance_GenericUDSService_toMachine: communication-connector=ServerConnector, service-instance=DiagTestApp_ProvidedSomeipServiceInstance_GenericUDSService, tcp-port=31402
  service instance to port prototype mapping Calculator_ProvidedSomeipServiceInstance_GenericUDSService_toPort: port-prototype=DiagTestAppRootSwc.GenericUDSService_SWCL_A, process=DiagTestAppProc, service-instance=DiagTestApp_ProvidedSomeipServiceInstance_GenericUDSService
  provided someip service instance DiagTestApp_ProvidedSomeipServiceInstance_DataIdentifier_SWCL_A_DID_4711: service-interface=DataIdentifier_SWCL_A_DID_4711_Someip, sd-server-config={initial-offer-behavior={initial-delay-max-value=0.1, initial-delay-min-value=0.01, initial-repetitions-base-delay=0.2, initial-repetitions-max=3}, offer-cyclic-delay=2.0, request-response-delay={max-value=1.5, min-value=1.5}, service-offer-time-to-live=3}, service-instance-id=2002
  someip service instance to machine mapping DiagTestApp_ProvidedSomeipServiceInstance_DataIdentifier_SWCL_A_DID_4711_toMachine: communication-connector=ServerConnector, service-instance=DiagTestApp_ProvidedSomeipServiceInstance_DataIdentifier_SWCL_A_DID_4711, tcp-port=31402
  service instance to port prototype mapping Calculator_ProvidedSomeipServiceInstance_DataIdentifier_SWCL_A_DID_4711_toPort: port-prototype=DiagTestAppRootSwc.DataIdentifier_SWCL_A_DID_4711, process=DiagTestAppProc, service-instance=DiagTestApp_ProvidedSomeipServiceInstance_DataIdentifier_SWCL_A_DID_4711
  provided someip service instance DiagTestApp_ProvidedSomeipServiceInstance_DataIdentifier_SWCL_A_DID_F190: service-interface=DataIdentifier_SWCL_A_DID_F190_Someip, sd-server-config={initial-offer-behavior={initial-delay-max-value=0.1, initial-delay-min-value=0.01, initial-repetitions-base-delay=0.2, initial-repetitions-max=3}, offer-cyclic-delay=2.0, request-response-delay={max-value=1.5, min-value=1.5}, service-offer-time-to-live=3}, service-instance-id=2003
  someip service instance to machine mapping DiagTestApp_ProvidedSomeipServiceInstance_DataIdentifier_SWCL_A_DID_F190_toMachine: communication-connector=ServerConnector, service-instance=DiagTestApp_ProvidedSomeipServiceInstance_DataIdentifier_SWCL_A_DID_F190, tcp-port=31402
  service instance to port prototype mapping Calculator_ProvidedSomeipServiceInstance_DataIdentifier_SWCL_A_DID_F190_toPort: port-prototype=DiagTestAppRootSwc.DataIdentifier_SWCL_A_DID_F190, process=DiagTestAppProc, service-instance=DiagTestApp_ProvidedSomeipServiceInstance_DataIdentifier_SWCL_A_DID_F190
  provided someip service instance DiagTestApp_ProvidedSomeipServiceInstance_RoutineControl_SWCL_A_RID_3009: service-interface=RoutineControl_SWCL_A_RID_3009_Someip, sd-server-config={initial-offer-behavior={initial-delay-max-value=0.1, initial-delay-min-value=0.01, initial-repetitions-base-delay=0.2, initial-repetitions-max=3}, offer-cyclic-delay=2.0, request-response-delay={max-value=1.5, min-value=1.5}, service-offer-time-to-live=3}, service-instance-id=2004
  someip service instance to machine mapping DiagTestApp_ProvidedSomeipServiceInstance_RoutineControl_SWCL_A_RID_3009_toMachine: communication-connector=ServerConnector, service-instance=DiagTestApp_ProvidedSomeipServiceInstance_RoutineControl_SWCL_A_RID_3009, tcp-port=31402
  service instance to port prototype mapping Calculator_ProvidedSomeipServiceInstance_RoutineControl_SWCL_A_RID_3009_toPort: port-prototype=DiagTestAppRootSwc.RoutineControl_SWCL_A_RID_3009, process=DiagTestAppProc, service-instance=DiagTestApp_ProvidedSomeipServiceInstance_RoutineControl_SWCL_A_RID_3009
