AUTOSAR XML (schema 00043)
package /vector/diag_test_app
  process DiagTestAppProc: executable=DiagTestAppExe
  startup config set ServerStartupConfigs
    startup config StartupModeIndependent: scheduling-policy=SCHEDULING-POLICY-ROUND-ROBIN, scheduling-priority=1, startup-option{option-argument=2, option-kind=COMMAND-LINE-LONG-FORM, option-name=floatArithmetic}
