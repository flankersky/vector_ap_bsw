AUTOSAR XML (schema 00043)
package /ara/diag
  service interface GenericUDSService
    namespaces:
      4 x symbol props:
        ara
        diag
        service_interfaces
        generic_uds_service
    methods:
      operation Service: possible-error=UDSServiceFailed
        5 x arg:
          SID: type=uint8, direction=IN
          RequestData: type=DataArrayType, direction=IN
          MetaInfo: type=MetaInfoType, direction=IN
          ResponseData: type=DataArrayType, direction=OUT
          errorContext: type=UDSResponseCodeType, direction=OUT
    error UDSServiceFailed: error-code=1, error-context=errorContext  # errorContext of UDSServiceFailed is of Type UDSResponseCodeType.
  service interface DM_IPC
    namespaces:
      4 x symbol props:
        ara
        diag
        service_interfaces
        dm_ipc
    methods:
      operation RequestData: possible-error=Failed
        4 x arg:
          handle: type=uint32, direction=IN
          meta_info: type=MetaInfoType, direction=IN
          request_data: type=DataArrayType, direction=IN
          response_data: type=DataArrayType, direction=OUT
    error Failed: error-code=1  # Generic communication failure
package /ara/diag/types
  5 x impl type:
    DataArrayType: category=VECTOR
      element byte: implementation-data-type=uint8
    UDSResponseCodeType: compu {0x10=kGeneralReject, 0x11=kServiceNotSupported, 0x12=kSubfunctionNotSupported, 0x13=kIncorrectMessageLengthOrInvalidFormat, 0x21=kBusyRepeatRequest, 0x22=kConditionsNotCorrect, 0x24=kRequestSequenceError, 0x25=kNoResponseFromSubnetComponent, 0x26=kFailurePreventsExecutionOfRequestedAction, 0x31=kRequestOutOfRange, 0x33=kSecurityAccessDenied, 0x35=kInvalidKey, 0x36=kExceedNumberOfAttempts, 0x37=kRequiredTimeDelayNotExpired, 0x70=kUploadDownloadNotAccepted, 0x71=kTransferDataSuspended, 0x72=kGeneralProgrammingFailure, 0x73=kWrongBlockSequenceCounter, 0x78=kRequestCorrectlyReceivedResponsePending, 0x7E=kSubFunctionNotSupportedInActiveSession, 0x7F=kServiceNotSupportedInActiveSession, 0xFF=kNoProcessingNoResponse}, implementation-data-type=uint8  # Represents UDS Error Codes, which can be returned by the external service processor.
    MetaInfoType: category=ASSOCIATIVE_MAP  # Meta-Inf map, which contains key-value pairs according to MetaInfoKeyType .
      element MetaInfoKey: implementation-data-type=MetaInfoKeyType
      element MetaInfoValue: implementation-data-type=MetaInfoValueType
    MetaInfoKeyType: compu {0x00=SA, 0x01=TA, 0x02=REQUEST_HANDLE, 0x03=REQUEST_TYPE, 0x06=SUPP_POS_RESP, 0x07=PROTOCOL_ID, 0x08=DOIP_LOCAL_IP, 0x09=DOIP_LOCAL_PORT, 0x0A=DOIP_REMOTE_IP, 0x0B=DOIP_REMOTE_PORT}, implementation-data-type=uint8  # Represents the predefined/valid keys, which are available within the optional MetaInfo the DM provides in service processor calls.
    MetaInfoValueType: category=STRING
