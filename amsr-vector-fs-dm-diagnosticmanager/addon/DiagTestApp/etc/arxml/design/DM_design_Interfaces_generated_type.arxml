AUTOSAR XML (schema 00043)
package /ara/diag
  service interface DataIdentifier_SWCL_A_DID_4711
    namespaces:
      4 x symbol props:
        ara
        diag
        service_interfaces
        data_identifier
    methods:
      operation Read: possible-error=DataIdentifier_SWCL_A_DID_4711/UDSServiceFailedOnRead
        4 x arg:
          MetaInfo: type=MetaInfoType, direction=IN
          dataRecord_DataElement_one: type=uint8, direction=OUT
          dataRecord_DataElement_two: type=uint16, direction=OUT
          errorContext: type=UDSResponseCodeType, direction=OUT
      operation Write: possible-error=DataIdentifier_SWCL_A_DID_4711/UDSServiceFailedOnWrite
        4 x arg:
          MetaInfo: type=MetaInfoType, direction=IN
          dataRecord_DataElement_one: type=uint8, direction=IN
          dataRecord_DataElement_two: type=uint16, direction=IN
          errorContext: type=UDSResponseCodeType, direction=OUT
      operation Cancel
        arg MetaInfo: type=MetaInfoType, direction=IN
    error UDSServiceFailedOnRead: error-code=1, error-context=Read/errorContext  # errorContext of UDSServiceFailedOnRead is of Type UDSResponseCodeType.
    error UDSServiceFailedOnWrite: error-code=1, error-context=Write/errorContext  # errorContext of UDSServiceFailedOnWrite is of Type UDSResponseCodeType.
  service interface DataIdentifier_SWCL_A_DID_F190
    namespaces:
      4 x symbol props:
        ara
        diag
        service_interfaces
        data_identifier_F190
    methods:
      operation Read: possible-error=DataIdentifier_SWCL_A_DID_F190/UDSServiceFailedOnRead
        arg MetaInfo: type=MetaInfoType, direction=IN
        arg dataRecord_vin: type=fixed_size_array_with_17_uint8_items, direction=OUT
        arg errorContext: type=UDSResponseCodeType, direction=OUT
      operation Write: possible-error=DataIdentifier_SWCL_A_DID_F190/UDSServiceFailedOnWrite
        arg MetaInfo: type=MetaInfoType, direction=IN
        arg dataRecord_vin: type=fixed_size_array_with_17_uint8_items, direction=IN
        arg errorContext: type=UDSResponseCodeType, direction=OUT
      operation Cancel
        arg MetaInfo: type=MetaInfoType, direction=IN
    error UDSServiceFailedOnRead: error-code=1, error-context=Read/errorContext  # errorContext of UDSServiceFailedOnRead is of Type UDSResponseCodeType.
    error UDSServiceFailedOnWrite: error-code=1, error-context=Write/errorContext  # errorContext of UDSServiceFailedOnWrite is of Type UDSResponseCodeType.
  service interface RoutineControl_SWCL_A_RID_3009
    namespaces:
      4 x symbol props:
        ara
        diag
        service_interfaces
        routine_control_3009
    methods:
      operation Start: possible-error=UDSServiceFailedOnStart
        4 x arg:
          MetaInfo: type=MetaInfoType, direction=IN
          Req_Reset: type=boolean, direction=IN
          Req_CounterLimit: type=uint32, direction=IN
          errorContext: type=UDSResponseCodeType, direction=OUT
      operation Stop: possible-error=UDSServiceFailedOnStop
        arg MetaInfo: type=MetaInfoType, direction=IN
        arg Resp_RemainingCounts: type=uint32, direction=OUT
        arg errorContext: type=UDSResponseCodeType, direction=OUT
      operation RequestResults: possible-error=UDSServiceFailedOnRequestResults
        arg MetaInfo: type=MetaInfoType, direction=IN
        arg Resp_RemainingCounts: type=uint32, direction=OUT
        arg errorContext: type=UDSResponseCodeType, direction=OUT
    error UDSServiceFailedOnStart: error-code=1, error-context=Start/errorContext  # errorContext of UDSServiceFailedOnStart is of Type UDSResponseCodeType.
    error UDSServiceFailedOnStop: error-code=1, error-context=Stop/errorContext  # errorContext of UDSServiceFailedOnStop is of Type UDSResponseCodeType.
    error UDSServiceFailedOnRequestResults: error-code=1, error-context=RequestResults/errorContext  # errorContext of UDSServiceFailedOnRequestResults is of Type UDSResponseCodeType.
package /ara/diag/types
  impl type fixed_size_array_with_17_uint8_items: category=ARRAY
    element Element: array-size=17, array-size-semantics=FIXED-SIZE, implementation-data-type=uint8
