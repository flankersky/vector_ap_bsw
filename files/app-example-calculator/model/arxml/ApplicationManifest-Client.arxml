AUTOSAR XML (schema 00043)
package /vector/calculator
  process calcClientProc: executable=amsrVectorAppExampleCalculatorClient, mode-dependent-startup-config{function-group=fg_com.Running, machine-mode=ClientMachineMode.Running, startup-config=StartupRunning}
    application mode machine ClientModes: type=MachineStates
  process to machine mapping set clientProcMachineMappingSet
    process to machine mapping clientProcMachineMapping: machine=ClientMachine, process=calcClientProc, shall-not-run-on=[core1, core2, core3], shall-run-on=core0
  startup config set ClientStartupConfigs
    startup config StartupRunning: scheduling-policy=SCHEDULING-POLICY-ROUND-ROBIN, scheduling-priority=30, startup-option{option-argument=/opt/amsrVectorAppExampleCalculatorClient/etc/application.json, option-kind=COMMAND-LINE-SHORT-FORM, option-name=c}
