AUTOSAR XML (schema 00043)
package /vector
  machine ClientMachine: service-discover-configs=someip-service-discovery={multicast-sd-ip-address=SdMulticastEndpoint, someip-service-discovery-port=12330}
    ethernet communication connector ClientConnector: unicast-network-endpoint=CalcNetworkEndpoint
    function-groups:
      mode declaration group prototype fg_com: type=MachineStates
    machine-mode-machines:
      mode declaration group prototype ClientMachineMode: type=MachineStates
    os module instantiation OsModule
      resource group OsModuleResources
    generic module instantiation ClientModule
    processor processor
      4 x processor core:
        core{0..3}
