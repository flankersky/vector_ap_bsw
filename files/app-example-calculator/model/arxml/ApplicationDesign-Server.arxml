AUTOSAR XML (schema 00043)
package /vector/calculator
  adaptive application sw component type calcServer
    provide port calcPortP: provided-interface=calculatorInterface
  executable amsrVectorAppExampleCalculatorServer: transformation-props-mapping-set=calcTransformationPropsOfInterface
    root sw component prototype calcServerRootSwc: application-type=calcServer
  adaptive autosar application adaptiveCalculatorServer: category=APPLICATION_LEVEL, executable=amsrVectorAppExampleCalculatorServer
