AUTOSAR XML (schema 00043)
package /vector
  machine ServerMachine: service-discover-configs=someip-service-discovery={multicast-sd-ip-address=SdMulticastEndpoint, someip-service-discovery-port=12330}
    ethernet communication connector ServerConnector: unicast-network-endpoint=CalcNetworkEndpoint
    machine-mode-machines:
      mode declaration group prototype ServerMachineMode: type=MachineStates
    os module instantiation OsModule
      resource group OsModuleResources
    generic module instantiation ServerModule
    processor processor
      4 x processor core:
        core{0..3}
