AUTOSAR XML (schema 00043)
package /vector/calculator
  process calcServerProc: executable=amsrVectorAppExampleCalculatorServer
    application mode machine ServerModes: type=MachineStates
    mode-dependent-startup-configs:
      machine-mode=ServerMachineMode.Running, startup-config=StartupRunning
      machine-mode=ServerMachineMode.Running2, startup-config=StartupRunning2
  process to machine mapping set serverProcMachineMappingSet
    process to machine mapping serverProcMachineMapping: machine=ServerMachine, process=calcServerProc, shall-not-run-on=[core1, core2, core3], shall-run-on=core0
  startup config set ServerStartupConfigs
    startup config StartupRunning: scheduling-policy=SCHEDULING-POLICY-ROUND-ROBIN, scheduling-priority=35, startup-option{option-argument=/opt/amsrVectorAppExampleCalculatorServer/etc/application.json, option-kind=COMMAND-LINE-SHORT-FORM, option-name=c}
    startup config StartupRunning2: scheduling-policy=SCHEDULING-POLICY-FIFO, scheduling-priority=2, startup-option{option-argument=/opt/amsrVectorAppExampleCalculatorServer/etc/application.json, option-kind=COMMAND-LINE-SHORT-FORM, option-name=c}
