AUTOSAR XML (schema 00043)
package /vector/calculator
  adaptive application sw component type calcClient
    require port calcPortR: required-interface=calculatorInterface
  executable amsrVectorAppExampleCalculatorClient: transformation-props-mapping-set=calcTransformationPropsOfInterface
    root sw component prototype calcClientRootSwc: application-type=calcClient
  adaptive autosar application adaptiveCalculatorClient: category=APPLICATION_LEVEL, executable=amsrVectorAppExampleCalculatorClient
