AUTOSAR XML (schema 00043)
package /vector/calculator
  someip data prototype transformation props subtractMethodTransformationProps: data-prototypes=calcPortP.arg1, someip-transformation-props=subtractMethodTransformationProps
  transformation props set calcTransformationProps
    ap someip transformation props calculatorInterfaceTransformationProps: alignment=16, byte-order=big-endian, session-handling=SESSION-HANDLING-ACTIVE, size-of-array-length-field=2, size-of-struct-length-field=1, size-of-union-length-field=1, size-of-union-type-selector-field=1
    ap someip transformation props subtractMethodTransformationProps: byte-order=big-endian
  transformation props to service interface element mapping set calcTransformationPropsOfInterface
    transformation props to service interface element mapping calculatorInterfacePropsToElementMapping: event=divisionByZero, field=divideResult, method=[subtract, add, divide], transformation-props=calculatorInterfaceTransformationProps
