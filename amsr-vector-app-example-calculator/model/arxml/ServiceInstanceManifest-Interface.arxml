AUTOSAR XML (schema 00043)
package /deployment
  someip service interface deployment calculatorInterface_Someip: service-interface=calculatorInterface, service-interface-id=1666, service-interface-version={major-version=1, minor-version=0}
    someip event deployment DivisionByZero: event=divisionByZero, event-id=45677, transport-protocol=TCP
    someip field deployment SomeipDivideResult: field=divideResult
      get getDivideResult: method-id=1701, transport-protocol=TCP
      notifier DivideResultNotifier: event-id=33010, transport-protocol=TCP
      set setDivideResult: method-id=1702, transport-protocol=TCP
    someip method deployment subtract: method=subtract, method-id=1666, transport-protocol=TCP
    someip method deployment add: method=add, method-id=1602, transport-protocol=TCP
    someip method deployment divide: method=divide, method-id=1603, transport-protocol=TCP
    someip event group DivideResult_Eventgroup: event-group-id=9087, event=DivideResultNotifier
    someip event group DivisionByZero_Eventgroup: event-group-id=888, event=DivisionByZero
