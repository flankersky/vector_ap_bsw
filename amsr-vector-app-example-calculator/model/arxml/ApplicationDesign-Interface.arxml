AUTOSAR XML (schema 00043)
package /vector/calculatorService
  service interface calculatorInterface
    namespaces:
      symbol props vector
      symbol props calculatorService
    events:
      data divisionByZero: type=boolean
    field divideResult: type=uint32, has-getter=true, has-notifier=true, has-setter=true, init-value=0
    methods:
      operation subtract
        arg arg1: type=uint32, direction=IN
        arg arg2: type=uint32, direction=IN
        arg result: type=uint32, direction=OUT
      operation add
        arg arg1: type=uint32, direction=IN
        arg arg2: type=uint32, direction=IN
        arg result: type=uint32, direction=OUT
      operation divide
        arg divident: type=uint32, direction=IN
        arg divisor: type=uint32, direction=IN
        arg result: type=uint32, direction=OUT
