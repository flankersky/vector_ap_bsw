AUTOSAR XML (schema 00043)
package /vector/calculator
  required someip service instance Calculator_RequiredSomeipServiceInstance: service-interface=calculatorInterface_Someip, required-service-instance-id=1403, required-service-version={major-version=1, minor-version=ANY}
    someip required event group Required_Divide_Eventgroup: event-group=DivideResult_Eventgroup
  someip service instance to machine mapping Calculator_RequiredSomeipServiceInstance_toMachine: communication-connector=ClientConnector, service-instance=Calculator_RequiredSomeipServiceInstance, tcp-port=31401
  service instance to port prototype mapping Calculator_RequiredSomeipServiceInstance_toPort: port-prototype=calcClientRootSwc.calcPortR, process=calcClientProc, service-instance=Calculator_RequiredSomeipServiceInstance
