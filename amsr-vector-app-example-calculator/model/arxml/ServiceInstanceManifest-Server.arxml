AUTOSAR XML (schema 00043)
package /vector/calculator
  provided someip service instance Calculator_ProvidedSomeipServiceInstance: service-interface=calculatorInterface_Someip, sd-server-config={initial-offer-behavior={initial-delay-max-value=0.1, initial-delay-min-value=0.01, initial-repetitions-base-delay=0.2, initial-repetitions-max=3}, offer-cyclic-delay=2.0, request-response-delay={max-value=1.5, min-value=1.5}, service-offer-time-to-live=3}, service-instance-id=1403
    someip provided event group Provided_DivideResult_Eventgroup: event-group=DivideResult_Eventgroup, multicast-threshold=3
    someip provided event group Provided_DivisionByZero_Eventgroup: event-group=DivisionByZero_Eventgroup, multicast-threshold=3
  someip service instance to machine mapping Calculator_ProvidedSomeipServiceInstance_toMachine: communication-connector=ServerConnector, service-instance=Calculator_ProvidedSomeipServiceInstance, tcp-port=31402
  service instance to port prototype mapping Calculator_ProvidedSomeipServiceInstance_toPort: port-prototype=calcServerRootSwc.calcPortP, process=calcServerProc, service-instance=Calculator_ProvidedSomeipServiceInstance
